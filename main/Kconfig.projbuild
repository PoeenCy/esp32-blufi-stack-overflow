## main/Kconfig.projbuild
```kconfig
menu "Example Configuration"

    config EXAMPLE_WIFI_CONNECTION_MAXIMUM_RETRY
        int "WiFi connection maximum retry"
        range 0 255
        default 2
        help
            WiFi connection maximum retry, from 0 to 255.

    menu "TFT Display Configuration"
        config BLUFI_DISPLAY_ENABLE
            bool "Enable TFT Display"
            default n
            help
                Enable TFT display support for showing BLUFI status

        if BLUFI_DISPLAY_ENABLE
            config BLUFI_DISPLAY_MOSI_PIN
                int "MOSI Pin"
                range 0 48
                default 23
                help
                    GPIO pin for SPI MOSI

            config BLUFI_DISPLAY_SCLK_PIN
                int "SCLK Pin"
                range 0 48
                default 18
                help
                    GPIO pin for SPI SCLK

            config BLUFI_DISPLAY_CS_PIN
                int "CS Pin"
                range 0 48
                default 5
                help
                    GPIO pin for SPI CS

            config BLUFI_DISPLAY_DC_PIN
                int "DC Pin"
                range 0 48
                default 2
                help
                    GPIO pin for Data/Command

            config BLUFI_DISPLAY_RST_PIN
                int "RST Pin"
                range 0 48
                default 4
                help
                    GPIO pin for Reset

            config BLUFI_DISPLAY_BL_PIN
                int "Backlight Pin"
                range -1 48
                default 15
                help
                    GPIO pin for Backlight (-1 to disable)
        endif
    endmenu

endmenu
```
